## tests/src/io/analog/testcase.yaml
```yaml
tests:
  analog.test:
    build_only: false
    platform_allow: native_sim/native/64
    harness: gtest
    tags:
      - host
      - preset
```

## tests/src/io/analog_filter/testcase.yaml
```yaml
tests:
  analog_filter.test:
    build_only: false
    platform_allow: native_sim/native/64
    harness: gtest
    timeout: 90
    tags:
      - host
```

## tests/src/io/digital/Kconfig
```kconfig
mainmenu "Project-specific configuration"

rsource "$ZEPHYR_PROJECT/app/Kconfig"
```

## tests/src/staged_update_reader/Kconfig
```kconfig
mainmenu "Project-specific configuration"

source "Kconfig.zephyr"
rsource "$ZENV_PROJECT_ROOT/app/logging/Kconfig"
```

## west.yml
```yaml
manifest:
  remotes:
    - name: zephyrproject-rtos
      url-base: https://github.com/zephyrproject-rtos
    - name: paradajz
      url-base: https://github.com/paradajz
    - name: olikraus
      url-base: https://github.com/olikraus
    - name: stm32duino
      url-base: https://github.com/stm32duino

  projects:
    - name: zephyr
      remote: zephyrproject-rtos
      revision: 2f9f440c2fc8105e6beeb2f711e4acfdda46dcd5
      import: true
    - name: u8g2
      remote: olikraus
      revision: 8430f65c9e2bc7ca393bf0e9d8cf58a84ae081d7
      path: modules/u8g2
      submodules: true
    - name: zlibs
      remote: paradajz
      revision: e4f650f94ac1268c027e82f3b53de99d34a19456
      path: modules/zlibs
    - name: vl53l4cx
      remote: stm32duino
      revision: 8ef5e558f4617ac52f559563e9ffe285a8b345f8
      path: modules/vl53l4cx
```
