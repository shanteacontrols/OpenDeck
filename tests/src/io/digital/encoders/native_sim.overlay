/ {
    gpio1: gpio1 {
        compatible = "zephyr,gpio-emul";
        rising-edge;
        falling-edge;
        high-level;
        low-level;
        gpio-controller;
        #gpio-cells = <2>;
        status = "okay";
    };

    adc: adc {
        compatible = "zephyr,adc-emul";
        nchannels = <8>;
        #io-channel-cells = <1>;
        status = "okay";
    };

    arduino_i2c: arduino_i2c@500 {
        compatible = "zephyr,i2c-emul-controller";
        #address-cells = <1>;
        #size-cells = <0>;
        #forward-cells = <1>;
        clock-frequency = <100000>;
        reg = <0x500 4>;
        status = "okay";
    };
};
