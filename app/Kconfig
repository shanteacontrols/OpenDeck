## app/dts/bindings/opendeck/opendeck-outputs.yaml
```yaml
description: OpenDeck output inventory and topology

compatible: "opendeck,outputs"

properties:
  mode:
    type: string
    required: false
    enum:
      - native
      - shift-register
      - matrix
      - max7219
    description: Physical output topology.

  touchscreen-components:
    type: int
    required: false
    default: 0
    description: Number of touchscreen-driven output-like components. Used only when touchscreen is used.

  native-gpios:
    type: phandle-array
    required: false
    description: Direct GPIO outputs for native output topology.

  shift-registers:
    type: int
    required: false
    description: Number of cascaded shift registers for shift-register output topology.

  data-gpios:
    type: phandle-array
    required: false
    description: Serial data output for shift-register or MAX7219 output topology.

  clock-gpios:
    type: phandle-array
    required: false
    description: Shift or serial clock for shift-register or MAX7219 output topology.

  latch-gpios:
    type: phandle-array
    required: false
    description: Latch or chip-select control for shift-register or MAX7219 output topology.

  enable-gpios:
    type: phandle-array
    required: false
    description: Optional output enable control for shift-register output topology.

  rows:
    type: int
    required: false
    description: Number of matrix output rows.

  columns:
    type: int
    required: false
    description: Number of matrix output columns.

  row-gpios:
    type: phandle-array
    required: false
    description: Matrix output row lines.

  column-gpios:
    type: phandle-array
    required: false
    description: Matrix output column lines.

  drivers:
    type: int
    required: false
    description: Number of MAX7219 output drivers.

  index-remap:
    type: array
    required: false
    description: Optional physical-to-logical output index remap table.
```

## app/dts/bindings/opendeck/opendeck-root.yaml
```yaml
description: OpenDeck top-level configuration container

compatible: "opendeck,root"

properties:
  disabled:
    type: boolean
    required: false
    description: Ignore this OpenDeck root node for target support checks.

  usb:
    type: boolean
    required: false
    description: USB transport support is present on this target.

  ble:
    type: boolean
    required: false
    description: BLE transport support is present on this target.

  buttons:
    type: phandle
    required: false
    description: Phandle to the OpenDeck button configuration node.

  analog:
    type: phandle
    required: false
    description: Phandle to the OpenDeck analog configuration node.

  leds:
    type: phandle
    required: false
    description: Phandle to the OpenDeck LED configuration node.

  touchscreen:
    type: phandle
    required: false
    description: Phandle to the OpenDeck touchscreen configuration node.

  din-midi:
    type: phandle
    required: false
    description: Phandle to the DIN MIDI UART configuration node.

  midi-indicators:
    type: phandle
    required: false
    description: Phandle to the MIDI traffic indicator configuration node.

  display:
    type: phandle
    required: false
    description: Phandle to the display I2C configuration node.

  bootloader:
    type: phandle
    required: false
    description: Phandle to the bootloader configuration node.
```

## app/dts/bindings/opendeck/opendeck-switches.yaml
```yaml
description: OpenDeck switch inventory and topology

compatible: "opendeck,switches"

properties:
  mode:
    type: string
    required: true
    enum:
      - native
      - matrix
      - shift-register
    description: Physical switch topology.

  native-gpios:
    type: phandle-array
    required: false
    description: Direct GPIO inputs for native switch topology.

  rows:
    type: int
    required: false
    description: Number of matrix rows for matrix topology.

  columns:
    type: int
    required: false
    description: Number of matrix columns for matrix topology.

  shift-registers:
    type: int
    required: false
    description: Number of cascaded 8-bit input shift registers for shift-register topology.

  row-mode:
    type: string
    required: false
    enum:
      - native
      - shift-register
    description: Physical row driver topology for matrix switches.

  row-gpios:
    type: phandle-array
    required: false
    description: Direct GPIO row signals for native matrix row topology.

  data-gpios:
    type: phandle-array
    required: false
    description: Serial data input from cascaded switch shift registers or matrix row shift registers.

  clock-gpios:
    type: phandle-array
    required: false
    description: Shift clock for cascaded switch shift registers or matrix row shift registers.

  latch-gpios:
    type: phandle-array
    required: false
    description: Latch or load control for cascaded switch shift registers or matrix row shift registers.

  column-mode:
    type: string
    required: false
    enum:
      - direct
      - decoder
    description: Physical column driver topology for matrix switches.

  column-gpios:
    type: phandle-array
    required: false
    description: Direct GPIO column signals for non-decoded matrix columns.

  decoder-a0-gpios:
    type: phandle-array
    required: false
    description: Decoder address bit 0 for matrix column selection.

  decoder-a1-gpios:
    type: phandle-array
    required: false
    description: Decoder address bit 1 for matrix column selection.

  decoder-a2-gpios:
    type: phandle-array
    required: false
    description: Decoder address bit 2 for matrix column selection.

  encoders:
    type: boolean
    required: false
    description: Enable logical encoder support derived from the switch topology.

  touchscreen-components:
    type: int
    required: false
    default: 0
    description: Number of touchscreen-driven switch-like components. Used only when touchscreen is used.

  index-remap:
    type: array
    required: false
    description: Optional physical-to-logical switch index remap table.
```

## app/dts/bindings/opendeck/opendeck-tests.yaml
```yaml
description: OpenDeck test capability configuration

compatible: "opendeck,tests"

properties:
  host:
    type: boolean
    required: false
    description: Enable this target for host-based test execution.
  hw:
    type: boolean
    required: false
    description: Enable this target for hardware-backed test execution.
```

## app/dts/bindings/opendeck/opendeck-touchscreen.yaml
```yaml
description: OpenDeck touchscreen inventory

compatible: "opendeck,touchscreen"

properties:
  component-count:
    type: int
    required: true
    description: Number of logical touchscreen components exposed to the firmware.

  uart:
    type: phandle
    required: false
    description: UART device used to communicate with the touchscreen. Usually provided in firmware.overlay and required when the touchscreen is used.
```

## app/dts/bindings/opendeck/opendeck-traffic-indicators.yaml
```yaml
description: OpenDeck traffic indicator Outputs

compatible: "opendeck,traffic-indicators"

properties:
  usb-in-gpios:
    type: phandle-array
    required: false
    description: GPIO driving the USB incoming traffic indicator output.

  usb-out-gpios:
    type: phandle-array
    required: false
    description: GPIO driving the USB outgoing traffic indicator output.

  ble-in-gpios:
    type: phandle-array
    required: false
    description: GPIO driving the BLE incoming traffic indicator output.

  ble-out-gpios:
    type: phandle-array
    required: false
    description: GPIO driving the BLE outgoing traffic indicator output.

  din-in-gpios:
    type: phandle-array
    required: false
    description: GPIO driving the DIN incoming traffic indicator output.

  din-out-gpios:
    type: phandle-array
    required: false
    description: GPIO driving the DIN outgoing traffic indicator output.

  network-in-gpios:
    type: phandle-array
    required: false
    description: GPIO driving the network incoming traffic indicator output.

  network-out-gpios:
    type: phandle-array
    required: false
    description: GPIO driving the network outgoing traffic indicator output.

  network-up-gpios:
    type: phandle-array
    required: false
    description: GPIO driving the network link/address status indicator output.
```

## app/dts/bindings/opendeck/opendeck-transports.yaml
```yaml
description: OpenDeck transport capability configuration

compatible: "opendeck,transports"

properties:
  usb:
    type: boolean
    required: false
    description: Controls whether USB transport is enabled for this OpenDeck image.

  network:
    type: boolean
    required: false
    description: Controls whether network transport is enabled for this OpenDeck image.

  ble:
    type: boolean
    required: false
    description: Controls whether BLE transport is enabled for this OpenDeck image.

  uart:
    type: phandle
    required: false
    description: Controls which UART device is used for DIN MIDI transport.
```
