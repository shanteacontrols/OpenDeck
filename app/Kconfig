## app/Kconfig
```kconfig
mainmenu "Project-specific configuration"

rsource "Kconfig.common"
rsource "firmware/Kconfig"
```

## app/Kconfig.common
```kconfig
source "Kconfig.zephyr"
rsource "Kconfig.logging"

config HW_BUILD
    bool
    default y if !BOARD_NATIVE_SIM_NATIVE_64
    help
      Hidden symbol indicating that the application is being built for
      hardware rather than host tests.
```

## app/Kconfig.sysbuild
```kconfig
source "$(ZEPHYR_BASE)/share/sysbuild/Kconfig"

choice FIRMWARE_LOADER

config FIRMWARE_LOADER_IMAGE_OPENDECK
    bool "OpenDeck bootloader recovery image"
    depends on MCUBOOT_MODE_FIRMWARE_UPDATER
    help
      Build the OpenDeck bootloader as MCUboot's firmware-loader image.
      In this mode slot1_partition contains the OpenDeck recovery image,
      not a pending application update.

endchoice

config FIRMWARE_LOADER_IMAGE_NAME
    default "opendeck_bootloader" if FIRMWARE_LOADER_IMAGE_OPENDECK

config FIRMWARE_LOADER_IMAGE_PATH
    default "$(ZENV_PROJECT_ROOT)/app/bootloader" if FIRMWARE_LOADER_IMAGE_OPENDECK
```

## app/bootloader/Kconfig
```kconfig
mainmenu "OpenDeck bootloader"

rsource "../Kconfig.logging"

OPENDECK_STAGED_DFU_NODE := $(dt_nodelabel_path,staged_dfu_partition)
OPENDECK_TRAFFIC_INDICATORS_NODE := $(dt_nodelabel_path,opendeck_traffic_indicators)
OPENDECK_TRANSPORTS_NODE := $(dt_nodelabel_path,opendeck_transports)

config PROJECT_BOOTLOADER_TRAFFIC_INDICATORS_DISABLED
    bool
    default y if !$(dt_path_enabled,$(OPENDECK_TRAFFIC_INDICATORS_NODE))

config PROJECT_BOOTLOADER_STAGED_UPDATE
    bool
    default y if $(dt_path_enabled,$(OPENDECK_STAGED_DFU_NODE))
    help
      Hidden symbol. If the target has a staged DFU partition, the
      bootloader can apply raw dfu.bin images written there by the
      application.

config PROJECT_BOOTLOADER_SUPPORT_USB_DFU
    bool "USB DFU support"
    default y if $(dt_path_enabled,$(OPENDECK_TRANSPORTS_NODE)) && \
             $(dt_nodelabel_bool_prop,opendeck_transports,usb)
    select NET_BUF
    select USB_DEVICE_STACK_NEXT
    select ZLIBS_DRIVERS_USB_HW
    select ZLIBS_DRIVERS_USB_20_EXTENSION_DESC
    help
      Enables the bootloader USB DFU transport when selected by the target
      USB configuration.

config PROJECT_BOOTLOADER_SUPPORT_TRAFFIC_INDICATORS
    bool
    default y if $(dt_path_enabled,$(OPENDECK_TRAFFIC_INDICATORS_NODE))
    help
      Hidden symbol indicating traffic indicator support is present
      in the bootloader when the chosen traffic indicators devicetree node
      exists.

config PROJECT_BOOTLOADER_SUPPORT_MDNS
    bool "mDNS recovery discovery support"
    default y if $(dt_path_enabled,$(OPENDECK_TRANSPORTS_NODE)) && \
             $(dt_nodelabel_bool_prop,opendeck_transports,network)
    select DNS_SD
    select ERRNO
    select HWINFO
    select MDNS_RESPONDER
    select MDNS_RESPONDER_DNS_SD
    select NETWORKING
    select NET_CONFIG_SETTINGS
    select NET_DHCPV4
    select NET_DHCPV4_OPTION_CALLBACKS
    select NET_HOSTNAME_DYNAMIC
    select NET_HOSTNAME_ENABLE
    select NET_IPV4
    select NET_CONFIG_NEED_IPV4
    help
      Enables bootloader mDNS advertisement for network recovery targets.

config PROJECT_BOOTLOADER_SUPPORT_WEBSOCKETS
    bool "WebSocket DFU support"
    default y if PROJECT_BOOTLOADER_SUPPORT_MDNS
    depends on PROJECT_BOOTLOADER_SUPPORT_MDNS
    select HTTP_SERVER
    select HTTP_SERVER_WEBSOCKET
    select NET_SOCKETS
    select NET_TCP
    help
      Enables the bootloader WebSocket DFU endpoint for network recovery
      targets.

source "Kconfig.zephyr"
```

## app/dts/bindings/opendeck/opendeck-analog.yaml
```yaml
description: OpenDeck analog input inventory and topology

compatible: "opendeck,analog"

properties:
  disabled:
    type: boolean
    required: false
    description: Ignore this analog node for target support and runtime collection sizing.

  mode:
    type: string
    required: true
    enum:
      - native
      - "4067"
      - muxonmux
    description: Physical analog frontend topology.

  io-channels:
    type: phandle-array
    required: false
    description: ADC channels used by the analog frontend. For native mode,
      one entry per logical analog input. For 4067 mode, one entry per mux
      output. For mux-on-mux mode, one entry for the controller output.

  multiplexers:
    type: int
    required: false
    description: Number of 16-channel analog multiplexers exposed by the topology.

  selector-s0-gpios:
    type: phandle-array
    required: false
    description: Shared selector S0 for 4067-based analog multiplexers.

  selector-s1-gpios:
    type: phandle-array
    required: false
    description: Shared selector S1 for 4067-based analog multiplexers.

  selector-s2-gpios:
    type: phandle-array
    required: false
    description: Shared selector S2 for 4067-based analog multiplexers.

  selector-s3-gpios:
    type: phandle-array
    required: false
    description: Shared selector S3 for 4067-based analog multiplexers.

  controller-s0-gpios:
    type: phandle-array
    required: false
    description: Controller multiplexer selector S0 for mux-on-mux topology.

  controller-s1-gpios:
    type: phandle-array
    required: false
    description: Controller multiplexer selector S1 for mux-on-mux topology.

  controller-s2-gpios:
    type: phandle-array
    required: false
    description: Optional controller multiplexer selector S2 for mux-on-mux topology.

  controller-s3-gpios:
    type: phandle-array
    required: false
    description: Optional controller multiplexer selector S3 for mux-on-mux topology.

  node-s0-gpios:
    type: phandle-array
    required: false
    description: Node multiplexer selector S0 for mux-on-mux topology.

  node-s1-gpios:
    type: phandle-array
    required: false
    description: Node multiplexer selector S1 for mux-on-mux topology.

  node-s2-gpios:
    type: phandle-array
    required: false
    description: Node multiplexer selector S2 for mux-on-mux topology.

  node-s3-gpios:
    type: phandle-array
    required: false
    description: Node multiplexer selector S3 for mux-on-mux topology.
```

## app/dts/bindings/opendeck/opendeck-bootloader.yaml
```yaml
description: OpenDeck bootloader entry configuration

compatible: "opendeck,bootloader"

properties:
  gpios:
    type: phandle-array
    required: true
    description: GPIO used to enter the OpenDeck recovery bootloader.

  label:
    type: string
    required: false
    description: Human-readable bootloader entry control name.
```

## app/dts/bindings/opendeck/opendeck-bulk-build.yaml
```yaml
description: OpenDeck bulk helper script configuration

compatible: "opendeck,bulk-build"

properties:
  app:
    type: boolean
    required: false
    description: Include this target in bulk firmware build runs launched by helper scripts.
  host-test:
    type: boolean
    required: false
    description: Include this target in bulk host test runs launched by helper scripts.
  hw-test:
    type: boolean
    required: false
    description: Include this target in bulk hardware test runs launched by helper scripts.
  lint:
    type: boolean
    required: false
    description: Include this target in bulk lint runs launched by helper scripts.
```

## app/dts/bindings/opendeck/opendeck-buttons.yaml
```yaml
description: OpenDeck button inventory and topology

compatible: "opendeck,buttons"

properties:
  mode:
    type: string
    required: true
    enum:
      - native
      - matrix
      - shift-register
    description: Physical button topology.

  native-gpios:
    type: phandle-array
    required: false
    description: Direct GPIO inputs for native button topology.

  rows:
    type: int
    required: false
    description: Number of matrix rows for matrix topology.

  columns:
    type: int
    required: false
    description: Number of matrix columns for matrix topology.

  shift-registers:
    type: int
    required: false
    description: Number of cascaded 8-bit input shift registers for shift-register topology.

  row-mode:
    type: string
    required: false
    enum:
      - native
      - shift-register
    description: Physical row driver topology for matrix buttons.

  row-gpios:
    type: phandle-array
    required: false
    description: Direct GPIO row signals for native matrix row topology.

  data-gpios:
    type: phandle-array
    required: false
    description: Serial data input from cascaded button shift registers or matrix row shift registers.

  clock-gpios:
    type: phandle-array
    required: false
    description: Shift clock for cascaded button shift registers or matrix row shift registers.

  latch-gpios:
    type: phandle-array
    required: false
    description: Latch or load control for cascaded button shift registers or matrix row shift registers.

  column-mode:
    type: string
    required: false
    enum:
      - direct
      - decoder
    description: Physical column driver topology for matrix buttons.

  column-gpios:
    type: phandle-array
    required: false
    description: Direct GPIO column signals for non-decoded matrix columns.

  decoder-a0-gpios:
    type: phandle-array
    required: false
    description: Decoder address bit 0 for matrix column selection.

  decoder-a1-gpios:
    type: phandle-array
    required: false
    description: Decoder address bit 1 for matrix column selection.

  decoder-a2-gpios:
    type: phandle-array
    required: false
    description: Decoder address bit 2 for matrix column selection.

  encoders:
    type: boolean
    required: false
    description: Enable logical encoder support derived from the button topology.

  touchscreen-components:
    type: int
    required: false
    default: 0
    description: Number of touchscreen-driven button-like components. Used only when touchscreen is used.

  index-remap:
    type: array
    required: false
    description: Optional physical-to-logical button index remap table.
```

## app/dts/bindings/opendeck/opendeck-display-i2c.yaml
```yaml
description: OpenDeck display I2C configuration

compatible: "opendeck,display-i2c"

properties:
  i2c:
    type: phandle
    required: false
    description: I2C controller used for the display. Usually provided in firmware.overlay and required when the display is used.
```

## app/dts/bindings/opendeck/opendeck-i2c.yaml
```yaml
description: OpenDeck I2C bus configuration

compatible: "opendeck,i2c"

properties:
  bus:
    type: phandle
    required: true
    description: I2C controller used by OpenDeck I2C peripherals.
```

## app/dts/bindings/opendeck/opendeck-leds.yaml
```yaml
description: OpenDeck LED inventory and topology

compatible: "opendeck,leds"

properties:
  mode:
    type: string
    required: false
    enum:
      - native
      - shift-register
      - matrix
      - max7219
    description: Physical LED output topology.

  touchscreen-components:
    type: int
    required: false
    default: 0
    description: Number of touchscreen-driven LED-like components. Used only when touchscreen is used.

  native-gpios:
    type: phandle-array
    required: false
    description: Direct GPIO outputs for native external LED topology.

  shift-registers:
    type: int
    required: false
    description: Number of cascaded shift registers for external LED shift-register topology.

  data-gpios:
    type: phandle-array
    required: false
    description: Serial data output for shift-register or MAX7219 LED topology.

  clock-gpios:
    type: phandle-array
    required: false
    description: Shift or serial clock for shift-register or MAX7219 LED topology.

  latch-gpios:
    type: phandle-array
    required: false
    description: Latch or chip-select control for shift-register or MAX7219 LED topology.

  enable-gpios:
    type: phandle-array
    required: false
    description: Optional output enable control for shift-register LED topology.

  rows:
    type: int
    required: false
    description: Number of matrix LED rows.

  columns:
    type: int
    required: false
    description: Number of matrix LED columns.

  row-gpios:
    type: phandle-array
    required: false
    description: Matrix LED row outputs.

  column-gpios:
    type: phandle-array
    required: false
    description: Matrix LED column outputs.

  drivers:
    type: int
    required: false
    description: Number of MAX7219 LED drivers.

  index-remap:
    type: array
    required: false
    description: Optional physical-to-logical LED index remap table.
```

## app/dts/bindings/opendeck/opendeck-metadata.yaml
```yaml
description: OpenDeck target metadata

compatible: "opendeck,metadata"

properties:
  zephyr-board:
    type: string
    required: true
    description: Base upstream Zephyr board target used by this OpenDeck target.

  board-name:
    type: string
    required: false
    description: Optional override for the runtime-facing OpenDeck board name used for USB, BLE, and DFU device naming.
```

## app/dts/bindings/opendeck/opendeck-midi-indicators.yaml
```yaml
description: OpenDeck MIDI traffic indicator LEDs

compatible: "opendeck,midi-indicators"

properties:
  usb-in-gpios:
    type: phandle-array
    required: false
    description: GPIO driving the USB MIDI incoming traffic indicator LED.

  usb-out-gpios:
    type: phandle-array
    required: false
    description: GPIO driving the USB MIDI outgoing traffic indicator LED.

  ble-in-gpios:
    type: phandle-array
    required: false
    description: GPIO driving the BLE MIDI incoming traffic indicator LED.

  ble-out-gpios:
    type: phandle-array
    required: false
    description: GPIO driving the BLE MIDI outgoing traffic indicator LED.

  din-in-gpios:
    type: phandle-array
    required: false
    description: GPIO driving the DIN MIDI incoming traffic indicator LED.

  din-out-gpios:
    type: phandle-array
    required: false
    description: GPIO driving the DIN MIDI outgoing traffic indicator LED.
```

## app/dts/bindings/opendeck/opendeck-midi-uart.yaml
```yaml
description: OpenDeck DIN MIDI UART configuration

compatible: "opendeck,midi-uart"

properties:
  uart:
    type: phandle
    required: false
    description: UART device used for DIN MIDI. Usually provided in firmware.overlay and required when DIN MIDI is used.
```
