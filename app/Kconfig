## app/firmware/Kconfig
```kconfig
OPENDECK_SWITCHES_NODE := $(dt_nodelabel_path,opendeck_switches)
OPENDECK_ANALOG_NODE := $(dt_nodelabel_path,opendeck_analog)
OPENDECK_OUTPUTS_NODE := $(dt_nodelabel_path,opendeck_outputs)
OPENDECK_TOUCHSCREEN_NODE := $(dt_nodelabel_path,opendeck_touchscreen)
OPENDECK_TRAFFIC_INDICATORS_NODE := $(dt_nodelabel_path,opendeck_traffic_indicators)
OPENDECK_I2C_NODE := $(dt_nodelabel_path,opendeck_i2c)
OPENDECK_STAGED_DFU_NODE := $(dt_nodelabel_path,staged_dfu_partition)
OPENDECK_TRANSPORTS_NODE := $(dt_nodelabel_path,opendeck_transports)

config PROJECT_TARGET_SWITCHES_DISABLED
    bool
    default y if !$(dt_path_enabled,$(OPENDECK_SWITCHES_NODE))

config PROJECT_TARGET_ANALOG_DISABLED
    bool
    default y if !$(dt_path_enabled,$(OPENDECK_ANALOG_NODE))

config PROJECT_TARGET_OUTPUTS_DISABLED
    bool
    default y if !$(dt_path_enabled,$(OPENDECK_OUTPUTS_NODE))

config PROJECT_TARGET_TOUCHSCREEN_DISABLED
    bool
    default y if !$(dt_path_enabled,$(OPENDECK_TOUCHSCREEN_NODE))

config PROJECT_TARGET_DIN_MIDI_DISABLED
    bool
    default y if !$(dt_path_enabled,$(OPENDECK_TRANSPORTS_NODE)) || \
             !$(dt_node_has_prop,$(OPENDECK_TRANSPORTS_NODE),uart)

config PROJECT_TARGET_TRAFFIC_INDICATORS_DISABLED
    bool
    default y if !$(dt_path_enabled,$(OPENDECK_TRAFFIC_INDICATORS_NODE))

config PROJECT_TARGET_DISPLAY_DISABLED
    bool
    default y if !$(dt_path_enabled,$(OPENDECK_I2C_NODE))

config PROJECT_TARGET_SUPPORT_SWITCHES
    bool
    default y if $(dt_path_enabled,$(OPENDECK_SWITCHES_NODE))
    help
      Hidden compatibility symbol indicating switch support is present on
      this target when the chosen OpenDeck switch devicetree node exists.

config PROJECT_TARGET_SUPPORT_DIGITAL_INPUTS
    bool
    default y if $(dt_path_enabled,$(OPENDECK_SWITCHES_NODE))
    help
      Hidden compatibility symbol indicating digital input support is
      present on this target when the chosen OpenDeck switch devicetree
      node exists.

config PROJECT_TARGET_SUPPORT_ENCODERS
    bool
    default y if $(dt_path_enabled,$(OPENDECK_SWITCHES_NODE)) && \
             $(dt_node_has_prop,$(OPENDECK_SWITCHES_NODE),encoders)
    help
      Hidden compatibility symbol indicating encoder support is present on
      this target when the chosen OpenDeck switch devicetree node
      explicitly enables encoders support.

config PROJECT_TARGET_DRIVER_DIGITAL_INPUT_NATIVE
    bool
    default y if $(dt_path_enabled,$(OPENDECK_SWITCHES_NODE)) && \
             $(dt_node_str_prop_equals,$(OPENDECK_SWITCHES_NODE),mode,native)
    help
      Hidden selector for the native switch GPIO backend.

config PROJECT_TARGET_DRIVER_DIGITAL_INPUT_SHIFT_REGISTER
    bool
    default y if $(dt_path_enabled,$(OPENDECK_SWITCHES_NODE)) && \
             $(dt_node_str_prop_equals,$(OPENDECK_SWITCHES_NODE),mode,shift-register)
    help
      Hidden selector for the shift-register switch backend.

config PROJECT_TARGET_DRIVER_DIGITAL_INPUT_MATRIX_NATIVE_ROWS
    bool
    default y if $(dt_path_enabled,$(OPENDECK_SWITCHES_NODE)) && \
             $(dt_node_str_prop_equals,$(OPENDECK_SWITCHES_NODE),mode,matrix) && \
             $(dt_node_str_prop_equals,$(OPENDECK_SWITCHES_NODE),row-mode,native)
    help
      Hidden selector for the matrix backend with native row inputs.

config PROJECT_TARGET_DRIVER_DIGITAL_INPUT_MATRIX_SHIFT_REGISTER_ROWS
    bool
    default y if $(dt_path_enabled,$(OPENDECK_SWITCHES_NODE)) && \
             $(dt_node_str_prop_equals,$(OPENDECK_SWITCHES_NODE),mode,matrix) && \
             $(dt_node_str_prop_equals,$(OPENDECK_SWITCHES_NODE),row-mode,shift-register)
    help
      Hidden selector for the matrix backend with shift-register row
      inputs.

config PROJECT_TARGET_SUPPORT_ADC
    bool
    default y if $(dt_path_enabled,$(OPENDECK_ANALOG_NODE))
    help
      Hidden compatibility symbol indicating ADC support is present on
      this target when the chosen OpenDeck analog devicetree node exists.

config PROJECT_TARGET_SUPPORT_TOUCHSCREEN
    bool
    default y if $(dt_path_enabled,$(OPENDECK_TOUCHSCREEN_NODE))
    select ZLIBS_DRIVERS_UART_HW
    help
      Hidden compatibility symbol indicating touchscreen support is
      present on this target when the chosen OpenDeck touchscreen
      devicetree node exists.

config PROJECT_TARGET_SUPPORT_OUTPUTS
    bool
    default y if $(dt_path_enabled,$(OPENDECK_OUTPUTS_NODE))
    default y if $(dt_path_enabled,$(OPENDECK_TOUCHSCREEN_NODE))
    help
      Hidden compatibility symbol indicating output support is present on
      this target when the chosen OpenDeck output devicetree node exists.

config PROJECT_TARGET_SUPPORT_DIGITAL_OUTPUTS
    bool
    default y if $(dt_path_enabled,$(OPENDECK_OUTPUTS_NODE))
    help
      Hidden compatibility symbol indicating digital output support is
      present on this target when the chosen OpenDeck output devicetree node
      exists.

config PROJECT_TARGET_DRIVER_DIGITAL_OUTPUT_NATIVE
    bool
    default y if $(dt_path_enabled,$(OPENDECK_OUTPUTS_NODE)) && \
             $(dt_node_str_prop_equals,$(OPENDECK_OUTPUTS_NODE),mode,native)
    help
      Hidden selector for the native output backend.

config PROJECT_TARGET_DRIVER_DIGITAL_OUTPUT_PWM
    bool
    select PWM
    default y if $(dt_path_enabled,$(OPENDECK_OUTPUTS_NODE)) && \
             $(dt_node_str_prop_equals,$(OPENDECK_OUTPUTS_NODE),mode,pwm)
    help
      Hidden selector for the PWM output backend.

config PROJECT_TARGET_DRIVER_DIGITAL_OUTPUT_SHIFT_REGISTER
    bool
    default y if $(dt_path_enabled,$(OPENDECK_OUTPUTS_NODE)) && \
             $(dt_node_str_prop_equals,$(OPENDECK_OUTPUTS_NODE),mode,shift-register)
    help
      Hidden selector for the shift-register output backend.

config PROJECT_TARGET_DRIVER_DIGITAL_OUTPUT_MATRIX_NATIVE_ROWS
    bool
    default y if $(dt_path_enabled,$(OPENDECK_OUTPUTS_NODE)) && \
             $(dt_node_str_prop_equals,$(OPENDECK_OUTPUTS_NODE),mode,matrix)
    help
      Hidden selector for the matrix output backend with native rows.

config PROJECT_TARGET_DRIVER_DIGITAL_OUTPUT_MAX7219
    bool
    default y if $(dt_path_enabled,$(OPENDECK_OUTPUTS_NODE)) && \
             $(dt_node_str_prop_equals,$(OPENDECK_OUTPUTS_NODE),mode,max7219)
    help
      Hidden selector for the MAX7219 output backend.

config PROJECT_TARGET_DRIVER_ANALOG_INPUT_NATIVE
    bool
    default y if $(dt_path_enabled,$(OPENDECK_ANALOG_NODE)) && \
             $(dt_node_str_prop_equals,$(OPENDECK_ANALOG_NODE),mode,native)
    help
      Hidden selector for the native analog input backend.

config PROJECT_TARGET_DRIVER_ANALOG_INPUT_MULTIPLEXER
    bool
    default y if $(dt_path_enabled,$(OPENDECK_ANALOG_NODE)) && \
             $(dt_node_str_prop_equals,$(OPENDECK_ANALOG_NODE),mode,4067)
    help
      Hidden selector for the shared-selector analog multiplexer backend.

config PROJECT_TARGET_DRIVER_ANALOG_INPUT_MUXONMUX
    bool
    default y if $(dt_path_enabled,$(OPENDECK_ANALOG_NODE)) && \
             $(dt_node_str_prop_equals,$(OPENDECK_ANALOG_NODE),mode,muxonmux)
    help
      Hidden selector for the mux-on-mux analog backend.

config PROJECT_TARGET_SWITCH_PHYSICAL_COUNT
    int
    default $(dt_node_prop_len,$(OPENDECK_SWITCHES_NODE),native-gpios) if PROJECT_TARGET_DRIVER_DIGITAL_INPUT_NATIVE
    default $(mul,$(dt_node_int_prop_int,$(OPENDECK_SWITCHES_NODE),shift-registers),8) if PROJECT_TARGET_DRIVER_DIGITAL_INPUT_SHIFT_REGISTER
    default $(mul,$(dt_node_int_prop_int,$(OPENDECK_SWITCHES_NODE),rows),$(dt_node_int_prop_int,$(OPENDECK_SWITCHES_NODE),columns)) if PROJECT_TARGET_DRIVER_DIGITAL_INPUT_MATRIX_NATIVE_ROWS
    default $(mul,$(dt_node_int_prop_int,$(OPENDECK_SWITCHES_NODE),rows),$(dt_node_int_prop_int,$(OPENDECK_SWITCHES_NODE),columns)) if PROJECT_TARGET_DRIVER_DIGITAL_INPUT_MATRIX_SHIFT_REGISTER_ROWS
    default 0
    help
      Hidden resolved physical switch count for the selected target.

config PROJECT_TARGET_SWITCH_HAS_REMAP
    int
    default 1 if $(dt_node_has_prop,$(OPENDECK_SWITCHES_NODE),index-remap)
    default 0
    help
      Hidden resolved switch remap presence for the selected target.

config PROJECT_TARGET_SWITCH_LOGICAL_COUNT
    int
    default $(dt_node_prop_len,$(OPENDECK_SWITCHES_NODE),index-remap) if $(dt_node_has_prop,$(OPENDECK_SWITCHES_NODE),index-remap)
    default PROJECT_TARGET_SWITCH_PHYSICAL_COUNT
    help
      Hidden resolved logical switch count for the selected target.

config PROJECT_TARGET_ENCODER_COUNT
    int
    default $(div,$(dt_node_prop_len,$(OPENDECK_SWITCHES_NODE),index-remap),2) if $(dt_node_has_prop,$(OPENDECK_SWITCHES_NODE),index-remap)
    default $(div,$(dt_node_prop_len,$(OPENDECK_SWITCHES_NODE),native-gpios),2) if PROJECT_TARGET_DRIVER_DIGITAL_INPUT_NATIVE
    default $(mul,$(dt_node_int_prop_int,$(OPENDECK_SWITCHES_NODE),shift-registers),4) if PROJECT_TARGET_DRIVER_DIGITAL_INPUT_SHIFT_REGISTER
    default $(div,$(mul,$(dt_node_int_prop_int,$(OPENDECK_SWITCHES_NODE),rows),$(dt_node_int_prop_int,$(OPENDECK_SWITCHES_NODE),columns)),2) if PROJECT_TARGET_DRIVER_DIGITAL_INPUT_MATRIX_NATIVE_ROWS
    default $(div,$(mul,$(dt_node_int_prop_int,$(OPENDECK_SWITCHES_NODE),rows),$(dt_node_int_prop_int,$(OPENDECK_SWITCHES_NODE),columns)),2) if PROJECT_TARGET_DRIVER_DIGITAL_INPUT_MATRIX_SHIFT_REGISTER_ROWS
    default 0
    help
      Hidden resolved encoder count for the selected target.

config PROJECT_TARGET_DIGITAL_INPUT_COUNT
    int
    default PROJECT_TARGET_SWITCH_PHYSICAL_COUNT
    help
      Hidden resolved digital input count for the selected target.

config PROJECT_TARGET_ANALOG_PHYSICAL_COUNT
    int
    default $(dt_node_prop_len,$(OPENDECK_ANALOG_NODE),io-channels) if PROJECT_TARGET_DRIVER_ANALOG_INPUT_NATIVE
    default $(mul,$(dt_node_prop_len,$(OPENDECK_ANALOG_NODE),io-channels),16) if PROJECT_TARGET_DRIVER_ANALOG_INPUT_MULTIPLEXER
    default 256 if PROJECT_TARGET_DRIVER_ANALOG_INPUT_MUXONMUX && $(dt_node_has_prop,$(OPENDECK_ANALOG_NODE),controller-s3-gpios)
    default 128 if PROJECT_TARGET_DRIVER_ANALOG_INPUT_MUXONMUX && $(dt_node_has_prop,$(OPENDECK_ANALOG_NODE),controller-s2-gpios)
    default 64 if PROJECT_TARGET_DRIVER_ANALOG_INPUT_MUXONMUX
    default 0
    help
      Hidden resolved physical analog input count for the selected target.

config PROJECT_TARGET_ANALOG_HAS_REMAP
    int
    default 1 if $(dt_node_has_prop,$(OPENDECK_ANALOG_NODE),index-remap)
    default 0
    help
      Hidden resolved analog remap presence for the selected target.

config PROJECT_TARGET_ANALOG_LOGICAL_COUNT
    int
    default $(dt_node_prop_len,$(OPENDECK_ANALOG_NODE),index-remap) if $(dt_node_has_prop,$(OPENDECK_ANALOG_NODE),index-remap)
    default PROJECT_TARGET_ANALOG_PHYSICAL_COUNT
    help
      Hidden resolved logical analog input count for the selected target.

config PROJECT_TARGET_OUTPUT_PHYSICAL_COUNT
    int
    default $(dt_node_prop_len,$(OPENDECK_OUTPUTS_NODE),native-gpios) if PROJECT_TARGET_DRIVER_DIGITAL_OUTPUT_NATIVE
    default $(dt_node_prop_len,$(OPENDECK_OUTPUTS_NODE),pwms) if PROJECT_TARGET_DRIVER_DIGITAL_OUTPUT_PWM
    default $(mul,$(dt_node_int_prop_int,$(OPENDECK_OUTPUTS_NODE),shift-registers),8) if PROJECT_TARGET_DRIVER_DIGITAL_OUTPUT_SHIFT_REGISTER
    default $(mul,$(dt_node_int_prop_int,$(OPENDECK_OUTPUTS_NODE),rows),$(dt_node_int_prop_int,$(OPENDECK_OUTPUTS_NODE),columns)) if PROJECT_TARGET_DRIVER_DIGITAL_OUTPUT_MATRIX_NATIVE_ROWS
    default $(mul,$(dt_node_int_prop_int,$(OPENDECK_OUTPUTS_NODE),drivers),64) if PROJECT_TARGET_DRIVER_DIGITAL_OUTPUT_MAX7219
    default 0
    help
      Hidden resolved physical output count for the selected target.

config PROJECT_TARGET_OUTPUT_HAS_REMAP
    int
    default 1 if $(dt_node_has_prop,$(OPENDECK_OUTPUTS_NODE),index-remap)
    default 0
    help
      Hidden resolved output remap presence for the selected target.

config PROJECT_TARGET_OUTPUT_LOGICAL_COUNT
    int
    default $(dt_node_prop_len,$(OPENDECK_OUTPUTS_NODE),index-remap) if $(dt_node_has_prop,$(OPENDECK_OUTPUTS_NODE),index-remap)
    default PROJECT_TARGET_OUTPUT_PHYSICAL_COUNT
    help
      Hidden resolved logical output count for the selected target.

config PROJECT_TARGET_TOUCHSCREEN_COMPONENT_COUNT
    int
    default $(dt_node_int_prop_int,$(OPENDECK_TOUCHSCREEN_NODE),component-count) if PROJECT_TARGET_SUPPORT_TOUCHSCREEN
    default 0
    help
      Hidden resolved touchscreen component count for the selected target.

config PROJECT_TARGET_EMUEEPROM_PAGE_SIZE
    int
    default $(dt_nodelabel_reg_size_int,emueeprom_page1_partition)
    help
      Hidden resolved logical EmuEEPROM page size for the selected target.

config PROJECT_TARGET_SUPPORT_I2C
    bool
    default y if $(dt_path_enabled,$(OPENDECK_I2C_NODE))
    help
      Hidden compatibility symbol indicating I2C support is present on
      this target when the chosen OpenDeck I2C devicetree node exists.

config PROJECT_TARGET_SUPPORT_DIN_MIDI
    bool
    default y if $(dt_path_enabled,$(OPENDECK_TRANSPORTS_NODE)) && \
             $(dt_node_has_prop,$(OPENDECK_TRANSPORTS_NODE),uart)
    select ZLIBS_DRIVERS_UART_HW
    select ZLIBS_UTILS_MIDI_TRANSPORT_SERIAL
    help
      Hidden symbol indicating DIN MIDI support is present on this target
      when the chosen OpenDeck transports devicetree node provides a DIN
      MIDI UART.

config PROJECT_TARGET_SUPPORT_BLE
    bool
    default y if $(dt_path_enabled,$(OPENDECK_TRANSPORTS_NODE)) && \
             $(dt_nodelabel_bool_prop,opendeck_transports,ble)
    select ZLIBS_UTILS_MIDI_TRANSPORT_BLE
    help
      Hidden symbol indicating BLE MIDI transport support is present on
      this target when the chosen OpenDeck transports devicetree node
      enables BLE.

config PROJECT_TARGET_SUPPORT_CONFIG_INTERFACE
    bool
    help
      Hidden symbol indicating at least one configuration transport is
      enabled for this target.

config PROJECT_TARGET_SUPPORT_CONFIG_INTERFACE_USB_MIDI
    bool
    help
      Hidden symbol indicating USB MIDI SysEx configuration support is
      enabled for this target.

config PROJECT_TARGET_SUPPORT_CONFIG_INTERFACE_WEBSOCKETS
    bool
    help
      Hidden symbol indicating WebSockets SysEx configuration support is
      enabled for this target.

config PROJECT_TARGET_SUPPORT_USB_MIDI
    bool "USB MIDI support"
    default y if $(dt_path_enabled,$(OPENDECK_TRANSPORTS_NODE)) && \
             $(dt_nodelabel_bool_prop,opendeck_transports,usb)
    select MIDI2_UMP_STREAM_RESPONDER
    select USBD_MIDI2_CLASS
    select ZLIBS_DRIVERS_USB_HW
    select ZLIBS_UTILS_MIDI_TRANSPORT_USB
    select PROJECT_TARGET_SUPPORT_CONFIG_INTERFACE
    select PROJECT_TARGET_SUPPORT_CONFIG_INTERFACE_USB_MIDI
    help
      Enables USB MIDI transport and SysEx configuration over USB.

config PROJECT_TARGET_SUPPORT_MIDI
    bool
    default y if PROJECT_TARGET_SUPPORT_USB_MIDI || \
             PROJECT_TARGET_SUPPORT_DIN_MIDI || \
             PROJECT_TARGET_SUPPORT_BLE
    help
      Hidden symbol indicating the MIDI protocol module is present when at
      least one MIDI transport is supported.

config PROJECT_TARGET_SUPPORT_TRAFFIC_INDICATORS
    bool
    default y if $(dt_path_enabled,$(OPENDECK_TRAFFIC_INDICATORS_NODE))
    help
      Hidden symbol indicating traffic indicator support is present
      on this target when the chosen traffic indicators devicetree node
      exists.

config PROJECT_TARGET_SUPPORT_USB_INDICATORS
    bool
    default y if $(dt_path_enabled,$(OPENDECK_TRAFFIC_INDICATORS_NODE)) && \
             $(dt_node_has_prop,$(OPENDECK_TRAFFIC_INDICATORS_NODE),usb_in_gpios) && \
             $(dt_node_has_prop,$(OPENDECK_TRAFFIC_INDICATORS_NODE),usb_out_gpios)
    help
      Hidden symbol indicating USB traffic indicators are present.

config PROJECT_TARGET_SUPPORT_DIN_INDICATORS
    bool
    default y if $(dt_path_enabled,$(OPENDECK_TRAFFIC_INDICATORS_NODE)) && \
             $(dt_node_has_prop,$(OPENDECK_TRAFFIC_INDICATORS_NODE),din_in_gpios) && \
             $(dt_node_has_prop,$(OPENDECK_TRAFFIC_INDICATORS_NODE),din_out_gpios)
    help
      Hidden symbol indicating DIN traffic indicators are present.

config PROJECT_TARGET_SUPPORT_BLE_INDICATORS
    bool
    default y if $(dt_path_enabled,$(OPENDECK_TRAFFIC_INDICATORS_NODE)) && \
             $(dt_node_has_prop,$(OPENDECK_TRAFFIC_INDICATORS_NODE),ble_in_gpios) && \
             $(dt_node_has_prop,$(OPENDECK_TRAFFIC_INDICATORS_NODE),ble_out_gpios)
    help
      Hidden symbol indicating BLE traffic indicators are present.

config PROJECT_TARGET_SUPPORT_NETWORK_INDICATORS
    bool
    default y if $(dt_path_enabled,$(OPENDECK_TRAFFIC_INDICATORS_NODE)) && \
             $(dt_node_has_prop,$(OPENDECK_TRAFFIC_INDICATORS_NODE),network_in_gpios) && \
             $(dt_node_has_prop,$(OPENDECK_TRAFFIC_INDICATORS_NODE),network_out_gpios)
    help
      Hidden symbol indicating network traffic indicators are present.

config PROJECT_TARGET_SUPPORT_NETWORK_UP_INDICATOR
    bool
    default y if $(dt_path_enabled,$(OPENDECK_TRAFFIC_INDICATORS_NODE)) && \
             $(dt_node_has_prop,$(OPENDECK_TRAFFIC_INDICATORS_NODE),network_up_gpios)
    help
      Hidden symbol indicating a network status indicator is present.

config PROJECT_TARGET_SUPPORT_NETWORK
    bool
    default y if $(dt_path_enabled,$(OPENDECK_TRANSPORTS_NODE)) && \
             $(dt_nodelabel_bool_prop,opendeck_transports,network)
    select FPU if CPU_HAS_FPU
    select FPU_SHARING if CPU_HAS_FPU
    select NETWORKING
    select NET_L2_ETHERNET
    select NET_IPV4
    select NET_ARP
    select NET_UDP
    select NET_DHCPV4
    select NET_DHCPV4_OPTION_CALLBACKS
    select NET_SOCKETS
    select NET_CONFIG_SETTINGS
    select NET_CONFIG_NEED_IPV4
    help
      Hidden symbol indicating IP network support is present on this target when
      Ethernet networking is enabled.

config PROJECT_TARGET_SUPPORT_OSC
    bool
    default y if PROJECT_TARGET_SUPPORT_NETWORK
    depends on PROJECT_TARGET_SUPPORT_NETWORK
    help
      Hidden symbol indicating OSC support is present on this target.

config PROJECT_TARGET_SUPPORT_WEBSOCKETS
    bool
    default y if PROJECT_TARGET_SUPPORT_NETWORK
    depends on PROJECT_TARGET_SUPPORT_NETWORK
    select NET_TCP
    select HTTP_SERVER
    select HTTP_SERVER_WEBSOCKET
    select PROJECT_TARGET_SUPPORT_CONFIG_INTERFACE
    select PROJECT_TARGET_SUPPORT_CONFIG_INTERFACE_WEBSOCKETS
    help
      Hidden symbol indicating WebSocket configuration support is present
      on this target.

config PROJECT_TARGET_SUPPORT_MDNS
    bool
    default y if PROJECT_TARGET_SUPPORT_WEBSOCKETS
    depends on PROJECT_TARGET_SUPPORT_NETWORK
    select DNS_SD
    select HWINFO
    select MDNS_RESPONDER
    select MDNS_RESPONDER_DNS_SD
    select NET_HOSTNAME_DYNAMIC
    select NET_HOSTNAME_ENABLE
    help
      Hidden symbol indicating mDNS and DNS-SD discovery support is present
      on this target.

config PROJECT_TARGET_SUPPORT_STAGED_UPDATE
    bool
    default y if $(dt_path_enabled,$(OPENDECK_STAGED_DFU_NODE))
    help
      Hidden symbol indicating staged DFU storage is present on this target.

config PROJECT_TARGET_SUPPORT_HOST_TEST
    bool
    default y if $(dt_nodelabel_bool_prop,opendeck_tests,host)
    help
      Hidden resolved flag indicating whether this target participates in
      host-side preset tests.

config PROJECT_TARGET_SUPPORT_HARDWARE_TEST
    bool
    default y if $(dt_nodelabel_bool_prop,opendeck_tests,hardware)
    help
      Hidden resolved flag indicating whether this target participates in
      hardware preset tests.

config PROJECT_TARGET_BULK_APP
    bool
    default y if $(dt_nodelabel_bool_prop,opendeck_bulk_build,app)
    help
      Hidden resolved flag indicating whether this target participates in
      bulk application builds.

config PROJECT_TARGET_BULK_HOST_TEST
    bool
    default y if $(dt_nodelabel_bool_prop,opendeck_bulk_build,host-test)
    help
      Hidden resolved flag indicating whether this target participates in
      bulk host-test runs.

config PROJECT_TARGET_BULK_HARDWARE_TEST
    bool
    default y if $(dt_nodelabel_bool_prop,opendeck_bulk_build,hardware-test)
    help
      Hidden resolved flag indicating whether this target participates in
      bulk hardware-test runs.

config PROJECT_TARGET_BULK_LINT
    bool
    default y if $(dt_nodelabel_bool_prop,opendeck_bulk_build,lint)
    help
      Hidden resolved flag indicating whether this target participates in
      bulk lint runs.

rsource "src/Kconfig"
```
