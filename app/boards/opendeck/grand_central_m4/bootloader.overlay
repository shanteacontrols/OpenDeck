/ {
    opendeck_bootloader: opendeck-bootloader {
        compatible = "opendeck,bootloader";
        gpios = <&portb 23 (GPIO_PULL_UP | GPIO_ACTIVE_LOW)>;
        label = "OpenDeck recovery";
    };

    opendeck_transports: opendeck-transports {
        compatible = "opendeck,transports";
        usb;
    };
};
