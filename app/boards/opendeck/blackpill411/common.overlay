opendeck_i2c_bus: &i2c1 {};

opendeck_uart_din_midi: &usart1 {};

opendeck_uart_touchscreen: &usart1 {};

/ {
    opendeck_traffic_indicators: opendeck-traffic-indicators {
        compatible = "opendeck,traffic-indicators";
        usb-in-gpios = <&gpioc 13 GPIO_ACTIVE_LOW>;
        usb-out-gpios = <&gpioc 13 GPIO_ACTIVE_LOW>;
        din-in-gpios = <&gpioc 13 GPIO_ACTIVE_LOW>;
        din-out-gpios = <&gpioc 13 GPIO_ACTIVE_LOW>;
    };
};
