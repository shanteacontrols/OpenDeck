opendeck_i2c_bus: &i2c0 {};

opendeck_uart_din_midi: &uart1 {};

opendeck_uart_touchscreen: &uart1 {};

/ {
    opendeck_traffic_indicators: opendeck-traffic-indicators {
        compatible = "opendeck,traffic-indicators";
        usb-in-gpios = <&gpio0 15 GPIO_ACTIVE_LOW>;
        usb-out-gpios = <&gpio0 16 GPIO_ACTIVE_LOW>;
        din-in-gpios = <&gpio0 13 GPIO_ACTIVE_LOW>;
        din-out-gpios = <&gpio0 14 GPIO_ACTIVE_LOW>;
        ble-in-gpios = <&gpio0 13 GPIO_ACTIVE_LOW>;
        ble-out-gpios = <&gpio0 14 GPIO_ACTIVE_LOW>;
    };
};
