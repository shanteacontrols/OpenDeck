opendeck_i2c_bus: &i2c1 {};

/ {
    opendeck_traffic_indicators: opendeck-traffic-indicators {
        compatible = "opendeck,traffic-indicators";
        usb-in-gpios = <&gpioa 10 GPIO_ACTIVE_HIGH>;
        usb-out-gpios = <&gpioa 9 GPIO_ACTIVE_HIGH>;
        din-in-gpios = <&gpioa 10 GPIO_ACTIVE_HIGH>;
        din-out-gpios = <&gpioa 9 GPIO_ACTIVE_HIGH>;
    };
};
