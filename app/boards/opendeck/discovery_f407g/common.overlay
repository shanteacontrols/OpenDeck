opendeck_uart_din_midi: &usart3 {};

opendeck_uart_touchscreen: &usart3 {};

/ {
    opendeck_traffic_indicators: opendeck-traffic-indicators {
        compatible = "opendeck,traffic-indicators";
        usb-in-gpios = <&gpiod 14 GPIO_ACTIVE_HIGH>;
        usb-out-gpios = <&gpiod 12 GPIO_ACTIVE_HIGH>;
        din-in-gpios = <&gpiod 15 GPIO_ACTIVE_HIGH>;
        din-out-gpios = <&gpiod 13 GPIO_ACTIVE_HIGH>;
    };
};
