## app/firmware/src/io/Kconfig
```kconfig
rsource "analog/Kconfig"
rsource "digital/Kconfig"
rsource "i2c/Kconfig"
rsource "outputs/Kconfig"
```

## app/firmware/src/io/analog/Kconfig
```kconfig
config ANALOG_THREAD_SLEEP_MS
    int "Analog thread loop sleep in milliseconds"
    range 0 1000
    default 1
    help
      Sleep interval used by the synchronous analog processing loop after
      each iteration. Set this to 0 in tests to yield instead of sleeping
      on wall-clock time.
```

## app/firmware/src/io/digital/Kconfig
```kconfig
config DIGITAL_THREAD_SLEEP_MS
    int "Digital thread loop sleep in milliseconds"
    range 0 1000
    default 1
    help
      Sleep interval used by the synchronous digital processing loop after
      each iteration. Set this to 0 in tests to yield instead of sleeping
      on wall-clock time.
```

## app/firmware/src/io/i2c/Kconfig
```kconfig
config I2C_THREAD_SLEEP_MS
    int "I2C thread loop sleep in milliseconds"
    range 0 1000
    default 1
    help
      Sleep interval used by the synchronous I2C processing loop after
      each iteration. Set this to 0 in tests to yield instead of sleeping
      on wall-clock time.
```

## app/firmware/src/protocol/Kconfig
```kconfig
rsource "midi/Kconfig"
rsource "osc/Kconfig"
rsource "websockets/Kconfig"
rsource "mdns/Kconfig"
```

## app/firmware/src/protocol/midi/Kconfig
```kconfig
menu "MIDI protocol"

config PROJECT_PROTOCOL_MIDI_USB_TX_QUEUE_SIZE
    int
    default USBD_MIDI2_TX_QUEUE_SIZE if USB_DEVICE_STACK_NEXT && USBD_MIDI2_CLASS
    default 256
    help
      Protocol-side USB MIDI TX burst limit. The MIDI handler uses this to
      keep USB bursts below the driver queue capacity, and tests can use it
      without enabling the hardware USB MIDI class.

endmenu
```

## app/logging/Kconfig
```kconfig
module = OPENDECK
module-str = OpenDeck
source "subsys/logging/Kconfig.template.log_config"
```

## tests/src/bootloader/dfu/staged_update_reader/Kconfig
```kconfig
mainmenu "Project-specific configuration"

source "Kconfig.zephyr"
rsource "$ZENV_PROJECT_ROOT/app/Kconfig.logging"
```

## tests/src/bootloader/protocols/webusb/Kconfig
```kconfig
mainmenu "Project-specific configuration"

rsource "$ZENV_PROJECT_ROOT/app/bootloader/Kconfig"
```

## tests/src/bootloader/testcase.yaml
```yaml
tests:
  bootloader.test:
    build_only: false
    platform_allow: native_sim/native/64
    harness: gtest
    tags: bootloader
```

## tests/src/firmware/dfu/staged_update_writer/Kconfig
```kconfig
mainmenu "Project-specific configuration"

config PROJECT_TARGET_SUPPORT_STAGED_UPDATE
    bool
    default y

rsource "$ZENV_PROJECT_ROOT/app/Kconfig"
```

## tests/src/firmware/dfu/staged_update_writer/testcase.yaml
```yaml
tests:
  firmware_dfu_staged_update_writer.test:
    build_only: false
    platform_allow: native_sim/native/64
    harness: gtest
    tags:
      - host
```

## tests/src/firmware/io/analog_filter/Kconfig
```kconfig
mainmenu "Project-specific configuration"

# The filter test is target-independent, but FilterHw stores state in
# Collection-sized arrays. Provide one analog slot without importing a
# real target config.
config PROJECT_TARGET_ANALOG_PHYSICAL_COUNT
    int
    default 1

config PROJECT_TARGET_ANALOG_LOGICAL_COUNT
    int
    default 1

rsource "$ZENV_PROJECT_ROOT/app/Kconfig"
```

## tests/src/firmware/io/digital/testcase.yaml
```yaml
tests:
  firmware_io_digital.test:
    build_only: false
    platform_allow: native_sim/native/64
    harness: gtest
    tags:
      - host
      - preset
```

## tests/src/firmware/io/i2c/Kconfig
```kconfig
mainmenu "Project-specific configuration"

source "Kconfig.zephyr"

rsource "$ZENV_PROJECT_ROOT/app/Kconfig.logging"

config PROJECT_TARGET_EMUEEPROM_PAGE_SIZE
    int
    default 65536

config PROJECT_TARGET_SWITCH_LOGICAL_COUNT
    int
    default 8

config PROJECT_TARGET_ENCODER_COUNT
    int
    default 4

config PROJECT_TARGET_ANALOG_LOGICAL_COUNT
    int
    default 6

config PROJECT_TARGET_ANALOG_PHYSICAL_COUNT
    int
    default 6

config PROJECT_TARGET_OUTPUT_LOGICAL_COUNT
    int
    default 3

config PROJECT_TARGET_TOUCHSCREEN_COMPONENT_COUNT
    int
    default 64

config PROJECT_TARGET_SUPPORT_I2C
    bool
    default y

config PROJECT_TARGET_SUPPORT_SWITCHES
    bool
    default y

config PROJECT_TARGET_SUPPORT_ENCODERS
    bool
    default y

config PROJECT_TARGET_SUPPORT_ADC
    bool
    default y

config PROJECT_TARGET_SUPPORT_OUTPUTS
    bool
    default y

config PROJECT_TARGET_SUPPORT_TOUCHSCREEN
    bool
    default y

rsource "$ZENV_PROJECT_ROOT/app/firmware/src/Kconfig"
```

## tests/src/firmware/io/i2c/testcase.yaml
```yaml
tests:
  firmware_io_i2c.test:
    build_only: false
    platform_allow: native_sim/native/64
    harness: gtest
    tags:
      - host
```

## tests/src/firmware/io/outputs/Kconfig
```kconfig
mainmenu "Project-specific configuration"

source "Kconfig.zephyr"
rsource "$ZENV_PROJECT_ROOT/app/Kconfig.logging"
rsource "$ZENV_PROJECT_ROOT/build/app/default/release/$TARGET/generated/target.kconfig"
rsource "$ZENV_PROJECT_ROOT/app/firmware/src/Kconfig"
```

## tests/src/firmware/protocol/mdns/Kconfig
```kconfig
mainmenu "Project-specific configuration"

config PROJECT_TARGET_EMUEEPROM_PAGE_SIZE
    int
    default 65536

config PROJECT_TARGET_SUPPORT_NETWORK
    bool
    default y

config PROJECT_TARGET_SUPPORT_WEBSOCKETS
    bool
    default y

config PROJECT_TARGET_SUPPORT_MDNS
    bool
    default y

rsource "$ZENV_PROJECT_ROOT/app/Kconfig"
```

## tests/src/firmware/protocol/mdns/testcase.yaml
```yaml
tests:
  firmware_protocol_mdns.test:
    build_only: false
    platform_allow: native_sim/native/64
    harness: gtest
    tags:
      - host
```

## tests/src/firmware/protocol/osc/Kconfig
```kconfig
mainmenu "Project-specific configuration"

config PROJECT_TARGET_EMUEEPROM_PAGE_SIZE
    int
    default 65536

config PROJECT_TARGET_SUPPORT_NETWORK
    bool
    default y

config PROJECT_TARGET_SUPPORT_OSC
    bool
    default y

rsource "$ZENV_PROJECT_ROOT/app/Kconfig"
```

## tests/src/firmware/protocol/websockets/testcase.yaml
```yaml
tests:
  firmware_protocol_websockets.test:
    build_only: false
    platform_allow: native_sim/native/64
    harness: gtest
    tags:
      - host
```

## tests/src/firmware/util/cinfo/Kconfig
```kconfig
mainmenu "Project-specific configuration"

config PROJECT_TARGET_EMUEEPROM_PAGE_SIZE
    int
    default 65536

rsource "$ZENV_PROJECT_ROOT/app/Kconfig"
```

## tests/src/hardware/testcase.yaml
```yaml
tests:
  hardware.test:
    build_only: false
    platform_allow: native_sim/native/64
    harness: gtest
    timeout: 180
    tags:
      - hardware
      - preset
```

## tests/src/hw/testcase.yaml
```yaml
tests:
  hw.test:
    build_only: false
    platform_allow: native_sim/native/64
    harness: gtest
    timeout: 180
    tags:
      - hw
      - preset
```
